## br2-streamer/Config.in
```kconfig
source "$BR2_EXTERNAL_STREAMER_PATH/package/librespot/Config.in"
source "$BR2_EXTERNAL_STREAMER_PATH/package/libldac/Config.in"
```

## br2-streamer/configs/streamer_zero2w_defconfig
```kconfig
# --- Board: Raspberry Pi Zero 2 W, 64-bit (based on raspberrypizero2w_64_defconfig)
BR2_aarch64=y
BR2_ARM_FPU_VFPV4=y
BR2_TOOLCHAIN_EXTERNAL=y
BR2_TOOLCHAIN_EXTERNAL_BOOTLIN=y
BR2_TOOLCHAIN_EXTERNAL_BOOTLIN_AARCH64_GLIBC_STABLE=y
# second directory: bluez-alsa volume mapping (see patches/bluez-alsa)
BR2_GLOBAL_PATCH_DIR="board/raspberrypi/patches $(BR2_EXTERNAL_STREAMER_PATH)/patches"
BR2_LINUX_KERNEL=y
BR2_LINUX_KERNEL_CUSTOM_TARBALL=y
BR2_LINUX_KERNEL_CUSTOM_TARBALL_LOCATION="$(call github,raspberrypi,linux,21b410140c47ffab5668399f6f143c7d7b935c8b)/linux-21b410140c47ffab5668399f6f143c7d7b935c8b.tar.gz"
BR2_LINUX_KERNEL_DEFCONFIG="bcm2711"
BR2_LINUX_KERNEL_CONFIG_FRAGMENT_FILES="$(BR2_EXTERNAL_STREAMER_PATH)/board/streamer/linux.fragment"
BR2_LINUX_KERNEL_DTS_SUPPORT=y
BR2_LINUX_KERNEL_INTREE_DTS_NAME="broadcom/bcm2710-rpi-zero-2-w"
BR2_LINUX_KERNEL_NEEDS_HOST_OPENSSL=y
BR2_PACKAGE_RPI_FIRMWARE=y
BR2_PACKAGE_RPI_FIRMWARE_BOOTCODE_BIN=y
BR2_PACKAGE_RPI_FIRMWARE_VARIANT_PI_CD=y
BR2_PACKAGE_RPI_FIRMWARE_CONFIG_FILE="$(BR2_EXTERNAL_STREAMER_PATH)/board/streamer/config.txt"
BR2_PACKAGE_RPI_FIRMWARE_CMDLINE_FILE="$(BR2_EXTERNAL_STREAMER_PATH)/board/streamer/cmdline.txt"
BR2_PACKAGE_BRCMFMAC_SDIO_FIRMWARE_RPI=y
BR2_PACKAGE_BRCMFMAC_SDIO_FIRMWARE_RPI_BT=y
BR2_PACKAGE_BRCMFMAC_SDIO_FIRMWARE_RPI_WIFI=y
# TP-Link UB500 / UB500 Plus (Realtek RTL8761BU) Bluetooth firmware
BR2_PACKAGE_LINUX_FIRMWARE=y
BR2_PACKAGE_LINUX_FIRMWARE_RTL_87XX_BT=y

# --- System: systemd, read-only root, hostname
BR2_INIT_SYSTEMD=y
BR2_INIT_SYSTEMD_VAR_FACTORY=y
# BR2_TARGET_GENERIC_REMOUNT_ROOTFS_RW is not set
BR2_TARGET_GENERIC_HOSTNAME="streamer"
BR2_TARGET_GENERIC_ISSUE="Streamer"
BR2_ROOTFS_OVERLAY="$(BR2_EXTERNAL_STREAMER_PATH)/board/streamer/rootfs-overlay"
BR2_ROOTFS_USERS_TABLES="$(BR2_EXTERNAL_STREAMER_PATH)/board/streamer/users.txt"
BR2_PACKAGE_BUSYBOX_CONFIG_FRAGMENT_FILES="$(BR2_EXTERNAL_STREAMER_PATH)/board/streamer/busybox.fragment"
BR2_ROOTFS_POST_BUILD_SCRIPT="board/raspberrypi/post-build.sh $(BR2_EXTERNAL_STREAMER_PATH)/board/streamer/post-build.sh"
BR2_ROOTFS_POST_IMAGE_SCRIPT="$(BR2_EXTERNAL_STREAMER_PATH)/board/streamer/post-image.sh"
BR2_PACKAGE_SYSTEMD_NETWORKD=y
BR2_PACKAGE_SYSTEMD_RESOLVED=y
BR2_PACKAGE_SYSTEMD_TIMESYNCD=y
BR2_PACKAGE_KMOD=y
BR2_PACKAGE_KMOD_TOOLS=y
# The Pi kernel installs .ko.xz drivers; libkmod must be able to decompress them.
BR2_PACKAGE_XZ=y
BR2_PACKAGE_E2FSPROGS=y
BR2_PACKAGE_E2FSPROGS_FSCK=y

# --- Network
BR2_PACKAGE_WPA_SUPPLICANT=y
BR2_PACKAGE_WPA_SUPPLICANT_CTRL_IFACE=y
BR2_PACKAGE_WPA_SUPPLICANT_CLI=y
BR2_PACKAGE_WPA_SUPPLICANT_PASSPHRASE=y
BR2_PACKAGE_IW=y
BR2_PACKAGE_WIRELESS_REGDB=y
BR2_PACKAGE_CA_CERTIFICATES=y
BR2_PACKAGE_OPENSSH=y
BR2_PACKAGE_DBUS=y
BR2_PACKAGE_AVAHI=y
BR2_PACKAGE_AVAHI_DAEMON=y

# --- Audio: ALSA, AirPlay 2, Spotify Connect, Bluetooth
BR2_PACKAGE_ALSA_UTILS=y
BR2_PACKAGE_ALSA_UTILS_APLAY=y
BR2_PACKAGE_ALSA_UTILS_AMIXER=y
BR2_PACKAGE_SHAIRPORT_SYNC=y
BR2_PACKAGE_SHAIRPORT_SYNC_AIRPLAY2=y
BR2_PACKAGE_SHAIRPORT_SYNC_LIBSOXR=y
BR2_PACKAGE_HOST_RUSTC=y
BR2_PACKAGE_HOST_RUST_BIN=y
BR2_PACKAGE_LIBRESPOT=y
BR2_PACKAGE_BLUEZ5_UTILS=y
BR2_PACKAGE_BLUEZ5_UTILS_CLIENT=y
BR2_PACKAGE_BLUEZ5_UTILS_TOOLS=y
BR2_PACKAGE_BLUEZ5_UTILS_DEPRECATED=y
BR2_PACKAGE_BLUEZ_ALSA=y
BR2_PACKAGE_BLUEZ_TOOLS=y
BR2_PACKAGE_LIBOPENAPTX=y
BR2_PACKAGE_FDK_AAC=y
# LDAC receive (Sony code as published by openvela, Apache-2.0); see README, "LDAC"
BR2_PACKAGE_LIBLDAC=y

# --- Network player (UPnP/DLNA): MPD plays, upmpdcli makes it visible to phones
BR2_PACKAGE_MPD=y
BR2_PACKAGE_MPD_CURL=y
BR2_PACKAGE_MPD_FFMPEG=y
BR2_PACKAGE_MPD_FLAC=y
BR2_PACKAGE_MPD_LIBSOXR=y
# BR2_PACKAGE_MPD_MAD is not set
BR2_PACKAGE_UPMPDCLI=y

# --- Images
BR2_TARGET_ROOTFS_EXT2=y
BR2_TARGET_ROOTFS_EXT2_4=y
BR2_TARGET_ROOTFS_EXT2_SIZE="512M"
# BR2_TARGET_ROOTFS_TAR is not set
BR2_PACKAGE_HOST_DOSFSTOOLS=y
BR2_PACKAGE_HOST_GENIMAGE=y
BR2_PACKAGE_HOST_KMOD_XZ=y
BR2_PACKAGE_HOST_MTOOLS=y
BR2_PACKAGE_HOST_E2FSPROGS=y
```

## br2-streamer/package/libldac/Config.in
```kconfig
config BR2_PACKAGE_LIBLDAC
	bool "libldac"
	help
	  Sony's LDAC Bluetooth audio codec library (encoder, decoder
	  and adaptive bit rate), in the version published by the
	  openvela project under the Apache License 2.0.

	  bluez-alsa uses it to receive LDAC.

	  LDAC is a trademark of Sony Corporation. The NOTICE file of
	  the source says that products using LDAC need Sony's
	  certification; this build is not certified.

	  https://github.com/open-vela/external_libldac
```

## br2-streamer/package/librespot/Config.in
```kconfig
config BR2_PACKAGE_LIBRESPOT
	bool "librespot"
	depends on BR2_PACKAGE_HOST_RUSTC_TARGET_ARCH_SUPPORTS
	select BR2_PACKAGE_HOST_RUSTC
	select BR2_PACKAGE_ALSA_LIB
	select BR2_PACKAGE_OPENSSL
	select BR2_PACKAGE_CA_CERTIFICATES
	select BR2_PACKAGE_AVAHI # runtime
	select BR2_PACKAGE_AVAHI_DAEMON # runtime
	select BR2_PACKAGE_DBUS # runtime
	help
	  Open source Spotify Connect client (ALSA backend, discovery
	  through the Avahi daemon, OpenSSL TLS).

	  https://github.com/librespot-org/librespot
```
